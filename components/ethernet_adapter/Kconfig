## components/ethernet_adapter/Kconfig
```kconfig
menu "Rover G16 Ethernet profile"

config ROVER_ETH_IPV4_ADDR
    string "Gateway static IPv4 address"
    default "192.168.2.166"

config ROVER_ETH_IPV4_GATEWAY
    string "IPv4 gateway / bench PC address"
    default "192.168.2.241"

config ROVER_ETH_IPV4_NETMASK
    string "IPv4 netmask"
    default "255.255.255.0"

endmenu
```

## sdkconfig.defaults
```kconfig
CONFIG_IDF_TARGET="esp32"
CONFIG_ESPTOOLPY_FLASHSIZE_2MB=y
CONFIG_COMPILER_OPTIMIZATION_SIZE=y
CONFIG_ESP_TASK_WDT_EN=y
CONFIG_ESP_TASK_WDT_INIT=y
CONFIG_ESP_TASK_WDT_TIMEOUT_S=5
CONFIG_ESP_MAIN_TASK_STACK_SIZE=4096
CONFIG_ETH_ENABLED=y
CONFIG_ETH_USE_ESP32_EMAC=y
CONFIG_ETH_PHY_INTERFACE_RMII=y
CONFIG_ETH_RMII_CLK_INPUT=y
CONFIG_ETH_RMII_CLK_IN_GPIO=0
CONFIG_ROVER_ETH_IPV4_ADDR="192.168.2.166"
CONFIG_ROVER_ETH_IPV4_GATEWAY="192.168.2.241"
CONFIG_ROVER_ETH_IPV4_NETMASK="255.255.255.0"
```
